#include <TVout.h>
#include <Keypad.h>


const byte ROWS = 4;
const byte COLS = 7;

char hexaKeys[ROWS][COLS] = {
  {'0','1','2','3','4','5','6'},
  {'7','8','9','A','B','C','D'},
  {'E','F','G','H','I','J','K'},
  {'L','M','N','O','P','Q','R'}
};

byte rowPins[ROWS] = {53, 51, 49, 47};
byte colPins[COLS] = {45, 43, 41, 39, 37, 35, 33};
Keypad customKeypad = Keypad( makeKeymap(hexaKeys), rowPins, colPins, ROWS, COLS); 

//double* x_rot( double x, double y, double z, double a){
//   double* s = (double*) malloc(3 * sizeof(double));
//   s[0] = x;
//   s[1] = y*cos(a)+z*sin(a);
//   s[2] = -y*sin(a)+z*cos(a);
//   return s;
//}

void x_rot( double* p, double a, double* nwpt){
   nwpt[0] = p[0];
   nwpt[1] = p[1]*cos(a) + p[2]*sin(a);
   nwpt[2] = -p[1]*sin(a) + p[2]*cos(a);
}

void y_rot( double* p, double a, double* nwpt ){
   nwpt[0] = p[0]*cos(a)+p[2]*sin(a);
   nwpt[1] = p[1];
   nwpt[2] = -p[0]*sin(a)+p[2]*cos(a);
}
void z_rot( double* p, double a, double* nwpt ){
   nwpt[0] =  p[0]*cos(a)+p[1]*sin(a);
   nwpt[1] = -p[0]*sin(a)+p[1]*cos(a);
   nwpt[2] = p[2];
}

//double* y_rot( double x, double y, double z, double a){
//   double s[] = { x*cos(a)+z*sin(a), y, -x*sin(a)+z*cos(a)};
//  return s;
//}
//
//double* z_rot( double x, double y, double z, double a){
//  double s[] = { x*cos(a)+y*sin(a), -x*sin(a)+y*cos(a), z};
//  return s;
//}


//static double* x_rot( double x, double x,  double a){
//   double s[] = { 
//    p[0],
//    (p[1]*cos(a)) + (p[2]*sin(a)),
//    (-p[1]*sin(a)) + (p[2]*cos(a))
//    };
//   return s;
//}

//double* y_rot( double p[3], double a){
//   double s[] = { 
//    p[0]*cos(a)+p[2]*sin(a),
//    p[1],
//    -p[0]*sin(a)+p[2]*cos(a)
//    };
//  return s;
//}
//
//double* z_rot( double p[3], double a){
//  double s[] = { 
//    p[0]*cos(a)+p[1]*sin(a),
//    -p[0]*sin(a)+p[1]*cos(a),
//    p[2]
//    };
//  return s;
//}


int w = 800;
int h = 60;
TVout TV;

//void set_pixel(int x, int y){
//  TV.set_pixel(x, y + 10 ,0x60 );
//}

void setup() {TV.begin(_NTSC,128,96);
Serial.begin(9600);}


// crt origin is 0, 10
// crt bottom right is is 105, 70
//full range (0,0) -> (104,60)


double vert[229][3] = {
  {0.0071, 0.003, -0.0335},
{-0.0526, 0.0309, -0.0437},
{-0.0109, 0.0312, -0.0297},
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{0.0233, 0.2425, -0.0418},
};


int vert_2d[229][2] = {
  {0, 0},
  {0, 0},
  {0, 0},
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  {0, 0},

};

int edge[526][2] = {
  {0, 1},
{1, 2},
{2, 0},
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{225, 228},
  
};
double b = 0.0;
double c = 1.0;
double g = 0.0;
double dis = 0.3;
bool spin = true;

void loop() {



char customKey = customKeypad.getKey();

if (spin){
  b += .17;
  c += .1;
  g += .14;
  if (customKey == 'O'){
  spin = false;
}
}
else
{

if (customKey == '1'){
  dis += .05;
}
else if (customKey == '2'){
  dis -= .05;
}
else if (customKey == '5'){
  c += .17;
}
else if (customKey == '6'){
  c -= .17;
}
else if (customKey == 'O'){
  spin = true;
}
}
//b += .057;
//c += .05;

for (int i = 70; i < 229; i++){
  //get vertex
  //double x = vert[i][0];
  //double y = vert[i][1];
  //double z = vert[i][2];
  //double s[] = { vert[i][0], vert[i][1]*cos(b)+vert[i][2]*sin(b), -vert[i][1]*sin(b)+vert[i][2]*cos(b)};
  double* s = (double*) malloc(3 * sizeof(double));

  //z_rot(vert[i], g, s);
  z_rot(vert[i], 3.14159/2, s);
  x_rot(s, b, s);
  
  //z_rot(s, g, s);
  s[2] += 2.;
  s[0]-=0.35;
  s[1]-=0.03;
  //z_rot(s, g, s);
  vert_2d[i][0] = round(       ( (s[1])/(s[2]*1+1) )*1000      )+64;
  vert_2d[i][1] = round(       ( -(s[0])/(s[2]*1+1) )*1000       )+48;
  free(s);
  //Serial.println(x_rot(vert[i],b)[1]);

}

TV.clear_screen();

TV.draw_line( 10, 5, 10, 10, 0x60 );
TV.draw_line( 10, 10, 12, 10, 0x60 );

TV.draw_line( 15, 5, 15, 9, 0x60 );
TV.draw_line( 15, 10, 18, 10, 0x60 );
TV.draw_line( 18, 5, 18, 10, 0x60 );

TV.draw_line( 22, 5, 22, 10, 0x60 );

TV.draw_line( 26, 5, 26, 10, 0x60 );
TV.draw_line( 26, 10, 28, 10, 0x60 );
TV.draw_line( 28, 8, 28, 10, 0x60 );
TV.draw_line( 26, 5, 28, 5, 0x60 );

TV.draw_line( 31, 5, 31, 10, 0x60 );

for (int i = 226; i < 526-136; i++){
  int x1 = vert_2d[ edge[i][0] ][0];
  int y1 = vert_2d[ edge[i][0] ][1];
  int x2 = vert_2d[ edge[i][1] ][0];
  int y2 = vert_2d[ edge[i][1] ][1];
  
  if (x1 == x2){
    TV.draw_line( x1, y1, x2, y2, 0x60 );
  }
  else if (y1 == y2){
    TV.draw_line( x1, y1, x2, y2, 0x60 );
  }
  else {
    TV.draw_line( x1, y1, x2, y2, 0x60 );
  }
  delay(10);
}

delay(1000);
b = fmod(b,999.0);
c = fmod(c,999.0);
g = fmod(g,999.0);

//for (int i = 0; i < 4; i++){
//TV.set_pixel(vert_2d[i][0], vert_2d[i][1], 0x60);
//}

//float x = 0.0;
//TV.draw_line(0,10,105,70,0x60);

//TV.draw_circle(50, 40, 15, 0x60);
//for(float i = 0.0; i <= 2*3.14159; i += .01){
//  set_pixel( round(sin(i)*15)+50, round(cos(i)*15)+30 );
//}


//TV.set_pixel(105,70 ,0x60 );
//TV.set_pixel(0,10 ,0x60 );
//TV.bitmap(10, 10, Pi);

}
